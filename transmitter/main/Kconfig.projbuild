## transmitter/main/Kconfig.projbuild
```kconfig
menu "Transmitter Configuration"

    config WIFI_SSID
        string "WiFi SSID"
        default "myssid"
        help
            SSID (network name) for the example to connect to.

    config WIFI_PASSWORD
        string "WiFi Password"
        default "mypassword"
        help
            WiFi password (WPA or WPA2) for the example to use.
            Can be left blank if the network has no security set.

    choice TRANSMITTER_IP_MODE
        prompt "IP Version"
        help
            Example can use either IPV4 or IPV6.

        config TRANSMITTER_IPV4
            bool "IPV4"

        config TRANSMITTER_IPV6
            bool "IPV6"

    endchoice

    config TRANSMITTER_IPV4_ADDR
        string "IPV4 Address"
        default "192.168.0.165"
        depends on TRANSMITTER_IPV4
        help
            IPV4 address to which the client example will send data.

    config TRANSMITTER_IPV6_ADDR
        string "IPV6 Address"
        default "FE80::30AD:E57B:C212:68AD"
        depends on TRANSMITTER_IPV6
        help
            IPV6 address to which the client example will send data.

    config TRANSMITTER_PORT
        int "Port"
        range 0 65535
        default 3333
        help
            The remote port to which the client example will send data.

endmenu
```
